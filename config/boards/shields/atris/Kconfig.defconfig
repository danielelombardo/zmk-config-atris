## config/boards/shields/atris/Kconfig.defconfig
```kconfig
if SHIELD_ATRIS_DONGLE

config ZMK_KEYBOARD_NAME
	default "atris"
	
config ZMK_SPLIT_ROLE_CENTRAL
	default y
	
endif

if SHIELD_ATRIS_LEFT || SHIELD_ATRIS_RIGHT || SHIELD_ATRIS_DONGLE 

config ZMK_SPLIT
	default y
	
endif
```

## config/boards/shields/atris/Kconfig.shield
```kconfig
config SHIELD_ATRIS_LEFT
	def_bool $(shields_list_contains,atris_left)

config SHIELD_ATRIS_RIGHT
	def_bool $(shields_list_contains,atris_right)

config SHIELD_ATRIS_DONGLE
	def_bool $(shields_list_contains,atris_dongle)
```
